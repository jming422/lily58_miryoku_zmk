// Copyright 2023 Manna Harbour
// https://github.com/manna-harbour/miryoku
// Customizations Copyright 2023 Jonathan Ming

#include "../miryoku/custom_config.h"
#include "../miryoku/mapping/58/lily58.h"
#include "../miryoku/miryoku.dtsi"

&left_encoder {
    steps = <29>;
    a-gpios = <&pro_micro 4 GPIO_PULL_UP>;
    b-gpios = <&pro_micro 5 GPIO_PULL_UP>;
};

&right_encoder {
    steps = <29>;
};
